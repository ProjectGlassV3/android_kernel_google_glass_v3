/* Copyright (c) 2018, The Linux Foundation. All rights reserved.
 *
 * This program is free software; you can redistribute it and/or modify
 * it under the terms of the GNU General Public License version 2 and
 * only version 2 as published by the Free Software Foundation.
 *
 * This program is distributed in the hope that it will be useful,
 * but WITHOUT ANY WARRANTY; without even the implied warranty of
 * MERCHANTABILITY or FITNESS FOR A PARTICULAR PURPOSE.  See the
 * GNU General Public License for more details.
 */

qcom,3507855_quanta_a65_825mah_averaged_masterslave_aug14th2018 {
	qcom, = <24>;
	/* #3507855_Quanta_A65_825mAh_averaged_MasterSlave_Aug14th2018*/
	qcom,max-voltage-uv = <4400000>;
	qcom,fg-cc-cv-threshold-mv = <4390>;
	qcom,nom-batt-capacity-mah = <825>;
	qcom,batt-id-kohm = <0>;
	qcom,battery-beta = <3435>;
	qcom,battery-type = "3507855_quanta_a65_825mah_averaged_masterslave_aug14th2018";
	qcom,checksum = <0x4EE0>;
	qcom,fastchg-current-ma = <1440>;
	qcom,gui-version = "PM660GUI - 0.0.0.45";
	qcom,jeita-fcc-ranges = <0 100 80000
				101 230 800000
				231 450 1440000
				451 600 400000>;
	qcom,jeita-fv-ranges = <0 100 4400000
				101 450 4400000
				451 600 4100000>;
	qcom,step-chg-ranges = <2600000 3000000 144000
				3001000 4200000 1440000
				4201000 4400000 800000>;
	qcom,fg-profile-data = [
		 26 22 68 0D
		 40 12 70 04
		 F6 1C 6D 01
		 BF 05 D2 02
		 3D 18 ED 22
		 BA 45 6C 52
		 96 00 00 00
		 14 00 00 00
		 00 00 AF CD
		 33 CD 44 CB
		 24 00 08 00
		 D1 E3 39 ED
		 F5 06 F7 EA
		 52 00 E4 12
		 18 1D A5 53
		 0C 06 09 20
		 27 00 14 00
		 D7 1F 47 05
		 E6 0A C3 05
		 C1 1C E5 02
		 15 0C 33 12
		 9A 18 34 23
		 0B 45 CC 53
		 69 00 00 00
		 10 00 00 00
		 00 00 79 D5
		 1D CB 7C AB
		 22 00 00 00
		 A7 EB 39 ED
		 56 F4 6C EA
		 8A 05 0D 02
		 55 FC 34 13
		 A1 33 CC FF
		 07 10 00 00
		 55 03 66 46
		 22 00 40 00
		 46 03 0A FA
		 FF 00 00 00
		 00 00 00 00
		 00 00 00 00
		 00 00 00 00
		 00 00 00 00
		 00 00 00 00
		 00 00 00 00
		 00 00 00 00
		 00 00 00 00
		 00 00 00 00
		 00 00 00 00
		 00 00 00 00
		 00 00 00 00
		 00 00 00 00
		 00 00 00 00
		 00 00 00 00
		 00 00 00 00
		 00 00 00 00
		 00 00 00 00
	];
};
