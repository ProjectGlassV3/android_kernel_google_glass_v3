## drivers/mcu/Kconfig
```kconfig
#
# MCU support
#
config ATMEL_APP_I2C
	tristate "Atmel application i2c driver module"
	depends on I2C
	help
	  Say Y here to enable basic touch reporting functionality.

	  If unsure, say N.
```

## drivers/misc/asic/Kconfig
```kconfig
menu "Kopin ASIC A254 support"

config ASIC_A254
	tristate "Kopin A254 support"
	depends on I2C
	help
	  Driver support for Kopin A254

endmenu
```

## drivers/misc/fpga/Kconfig
```kconfig
menu "Lattice FPGA support"

config FPGA_LIFMD6000
	tristate "Lattice LIF-MD6000 support"
	depends on I2C
	help
	  Driver support for Lattice LIFMD series

endmenu
```
